## Slave/firmware/esp32s3/sdkconfig.defaults
```kconfig
CONFIG_ESPTOOLPY_FLASHSIZE_16MB=y
CONFIG_PARTITION_TABLE_CUSTOM=y
CONFIG_PARTITION_TABLE_CUSTOM_FILENAME="partitions.csv"
CONFIG_COMPILER_OPTIMIZATION_SIZE=y
CONFIG_ESP_COREDUMP_ENABLE_TO_NONE=y
CONFIG_BOOTLOADER_APP_ROLLBACK_ENABLE=y
CONFIG_SPIRAM=y
CONFIG_SPIRAM_MODE_OCT=y
CONFIG_SPIRAM_SPEED_80M=y
CONFIG_SPIRAM_USE_MALLOC=y
CONFIG_CAMERA_PSRAM_DMA=y
# CONFIG_OV7670_SUPPORT is not set
# CONFIG_OV7725_SUPPORT is not set
# CONFIG_NT99141_SUPPORT is not set
# CONFIG_OV2640_SUPPORT is not set
CONFIG_OV3660_SUPPORT=y
# CONFIG_OV5640_SUPPORT is not set
# CONFIG_GC2145_SUPPORT is not set
# CONFIG_GC032A_SUPPORT is not set
# CONFIG_GC0308_SUPPORT is not set
# CONFIG_BF3005_SUPPORT is not set
# CONFIG_BF20A6_SUPPORT is not set
# CONFIG_SC101IOT_SUPPORT is not set
# CONFIG_SC030IOT_SUPPORT is not set
# CONFIG_SC031GS_SUPPORT is not set
# CONFIG_HM1055_SUPPORT is not set
# CONFIG_HM0360_SUPPORT is not set
# CONFIG_MEGA_CCM_SUPPORT is not set
CONFIG_AINEKIO_PIN_MAP_B=y
CONFIG_AINEKIO_PHYSICAL_MOTION_ENABLED=y
CONFIG_AINEKIO_MOTION_RANGE_PERCENT=25
CONFIG_AINEKIO_MOTION_MIN_FRAME_MS=100
CONFIG_AINEKIO_SERVO_STARTUP_STAGGER_MS=20
CONFIG_AINEKIO_BATTERY_MONITOR_ENABLED=y
CONFIG_AINEKIO_BATTERY_DIVIDER_FACTOR="3.12766"
```
