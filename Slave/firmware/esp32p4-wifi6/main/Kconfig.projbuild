## Slave/firmware/esp32p4-wifi6/main/Kconfig.projbuild
```kconfig
menu "Ainekio wide face LCD"
config AINEKIO_LCD_ENABLED
    bool "Use the 1.9-inch ST7789 SPI LCD"
    default y
config AINEKIO_LCD_SCLK
    int "LCD SCL / SCK GPIO"
    default 20
config AINEKIO_LCD_MOSI
    int "LCD SDA / DIN GPIO (SPI, not I2C)"
    default 21
config AINEKIO_LCD_CS
    int "LCD CS GPIO"
    default 22
config AINEKIO_LCD_DC
    int "LCD DC GPIO"
    default 23
config AINEKIO_LCD_RESET
    int "LCD RES / RST GPIO"
    default 26
config AINEKIO_LCD_SPI_HZ
    int "LCD SPI clock in Hz"
    default 40000000
config AINEKIO_LCD_FPS
    int "Face rendering frames per second"
    range 1 120
    default 30
config AINEKIO_LCD_Y_GAP
    int "Landscape row offset in ST7789 RAM"
    default 35
config AINEKIO_LCD_ROTATE_180
    bool "Rotate the landscape screen 180 degrees"
    default y
config AINEKIO_LCD_BGR
    bool "Panel uses BGR color order"
    default n
config AINEKIO_LCD_INVERT
    bool "Panel requires inverted pixel drive"
    default y
endmenu
```

## Slave/firmware/esp32p4-wifi6/sdkconfig.defaults
```kconfig
CONFIG_IDF_TARGET="esp32p4"
CONFIG_ESP32P4_SELECTS_REV_LESS_V3=y
CONFIG_ESP32P4_REV_MIN_100=y
CONFIG_PARTITION_TABLE_CUSTOM=y
CONFIG_PARTITION_TABLE_CUSTOM_FILENAME="partitions.csv"
CONFIG_PARTITION_TABLE_OFFSET=0x8000
CONFIG_ESPTOOLPY_FLASHMODE_QIO=y
CONFIG_ESPTOOLPY_FLASHSIZE_32MB=y
CONFIG_BOOTLOADER_LOG_LEVEL_WARN=y
CONFIG_COMPILER_OPTIMIZATION_PERF=y
CONFIG_SPIRAM=y
CONFIG_SPIRAM_SPEED_200M=y
CONFIG_FREERTOS_HZ=1000
CONFIG_ESP_MAIN_TASK_STACK_SIZE=12288
CONFIG_ESP_CONSOLE_UART_DEFAULT=y
CONFIG_ESP_CONSOLE_UART_BAUDRATE=115200
CONFIG_GPIO_CTRL_FUNC_IN_IRAM=y
CONFIG_I2C_ENABLE_DEBUG_LOG=y
CONFIG_ESP_TASK_WDT_PANIC=y
CONFIG_ESP_SYSTEM_PANIC_PRINT_REBOOT=y
CONFIG_ESP_WIFI_SOFTAP_SUPPORT=y
CONFIG_ESP_WIFI_REMOTE_LIBRARY_HOSTED=y
CONFIG_ESP_HOSTED_CP_TARGET_ESP32C6=y
CONFIG_ESP_HOSTED_SDIO_HOST_INTERFACE=y
CONFIG_ESP_HOSTED_SDIO_SLOT_1=y
CONFIG_ESP_HOSTED_SDIO_4_BIT_BUS=y
CONFIG_ESP_HOSTED_SDIO_CLOCK_FREQ_KHZ=40000
# Pre-V3 P4 releases most internal RAM only after the main task starts.
# Hosted allocates its transport pools earlier, in a global constructor.
CONFIG_ESP_HOSTED_SDIO_TX_Q_SIZE=8
CONFIG_ESP_HOSTED_SDIO_RX_Q_SIZE=8
CONFIG_ESP_HOSTED_SDIO_OPTIMIZATION_RX_NONE=y
CONFIG_ESP_HOSTED_PRIV_SDIO_PIN_CMD_SLOT_1=19
CONFIG_ESP_HOSTED_PRIV_SDIO_PIN_CLK_SLOT_1=18
CONFIG_ESP_HOSTED_PRIV_SDIO_PIN_D0_SLOT_1=14
CONFIG_ESP_HOSTED_PRIV_SDIO_PIN_D1_4BIT_BUS_SLOT_1=15
CONFIG_ESP_HOSTED_PRIV_SDIO_PIN_D2_4BIT_BUS_SLOT_1=16
CONFIG_ESP_HOSTED_PRIV_SDIO_PIN_D3_4BIT_BUS_SLOT_1=17
CONFIG_ESP_HOSTED_SDIO_GPIO_RESET_SLAVE=54
CONFIG_MBEDTLS_CERTIFICATE_BUNDLE=y
CONFIG_CODEC_ES8311_SUPPORT=y
CONFIG_CODEC_ES7210_SUPPORT=n
CONFIG_CODEC_ES7243_SUPPORT=n
CONFIG_CODEC_ES7243E_SUPPORT=n
CONFIG_CODEC_ES8156_SUPPORT=n
CONFIG_CODEC_AW88298_SUPPORT=n
CONFIG_CODEC_ES8389_SUPPORT=n
CONFIG_CODEC_ES8374_SUPPORT=n
CONFIG_CODEC_ES8388_SUPPORT=n
CONFIG_CODEC_TAS5805M_SUPPORT=n
CONFIG_ESP_VIDEO_ENABLE_MIPI_CSI_VIDEO_DEVICE=y
CONFIG_ESP_VIDEO_ENABLE_ISP_PIPELINE_CONTROLLER=y
CONFIG_ESP_VIDEO_ENABLE_DVP_VIDEO_DEVICE=n
CONFIG_ESP_VIDEO_ENABLE_HW_JPEG_ENC_VIDEO_DEVICE=n
CONFIG_ESP_VIDEO_ENABLE_HW_H264_VIDEO_DEVICE=n
CONFIG_ESP_VIDEO_ENABLE_USB_UVC_VIDEO_DEVICE=n
CONFIG_CAMERA_OV5647=y
CONFIG_CAMERA_OV5647_MIPI_RAW10_1280X960_BINNING_45FPS=y
CONFIG_CAMERA_OV5647_MIPI_DEFAULT_FMT_RAW10_1280X960_BINNING_45FPS=y
```

## Slave/firmware/esp32s3/components/ainekio_platform/Kconfig
```kconfig
menu "Ainekio platform"

config AINEKIO_PIN_MAP_B
    bool "Use Freenove N16R8 MAP_B board-only servo remap"
    default y
    help
        Builds the Freenove ESP32-S3 N16R8 allocation with all eight servo
        outputs on exposed GPIOs. GPIO0 and GPIO43 hand off their boot-time
        roles to the OLED I2C bus; GPIO47 and GPIO48 drive servos R4 and R3.

config AINEKIO_PHYSICAL_MOTION_ENABLED
    bool "Enable all eight servo outputs and semantic motion"
    default y
    help
        Enables all eight MAP_B servo outputs after platform initialization and
        permits normal semantic motion plus calibration commands. Startup keeps
        the 20 ms channel stagger; the pin-map guard rejects any future servo
        assignment on N16R8 PSRAM GPIO33-37.

config AINEKIO_MOTION_RANGE_PERCENT
    int "Initial motion range around logical center (percent)"
    range 10 100
    default 100
    help
        Scales every platform motion target around logical center 90 degrees.
        The default preserves the source 0-180 degree Sesame motion range.
        Installed linkage limits remain enforced by per-servo calibration.

config AINEKIO_MOTION_MIN_FRAME_MS
    int "Minimum platform motion frame duration (milliseconds)"
    range 20 1000
    default 20
    help
        Sets the minimum motion frame duration. The default preserves Sesame's
        20 ms delay between individual servo writes.

config AINEKIO_MOTION_SMOOTH_PLAYBACK
    bool "Smooth Sesame motion asset playback"
    default y
    help
        Keeps the original Sesame motion targets and total frame durations, but
        moves all targets in each source frame together with bounded
        ease-in/ease-out interpolation. Disable this option to reproduce the
        original sequential 20 ms servo writes exactly.

config AINEKIO_MOTION_SMOOTH_TRANSITION_MS
    int "Smooth motion transition duration (milliseconds)"
    range 20 500
    default 120
    depends on AINEKIO_MOTION_SMOOTH_PLAYBACK
    help
        Limits how long a source frame spends approaching its target. Any
        remaining frame time holds the target, so the original motion asset's
        overall timing does not increase.

config AINEKIO_SERVO_STARTUP_STAGGER_MS
    int "Delay between enabling servo channels at startup (milliseconds)"
    range 0 200
    default 20
    help
        Enables the eight centered 50 Hz outputs sequentially to reduce the
        instantaneous current step, following the Sesame firmware pattern.

config AINEKIO_BATTERY_MONITOR_ENABLED
    bool "Enable the GPIO3 battery divider and cutoff monitor"
    default y
    help
        Samples the planned 100k/47k divider on GPIO3, reports battery voltage,
        and applies the configured warning, cutoff, and recovery guards. H9
        refines the ADC correction against a multimeter; it does not gate
        initial monitoring.

config AINEKIO_MIC_SLOT_RIGHT
    bool "INMP441 drives the right I2S slot"
    default n
    help
        Select this only when the microphone L/R strap is wired for the right
        channel. The default reads the left slot and must be verified at H2/H4.

config AINEKIO_SSD1306_ADDRESS
    hex "SSD1306 7-bit I2C address"
    range 0x3c 0x3d
    default 0x3c
    help
        The common SSD1306 module address. H2 must verify the installed display;
        display initialization failure never blocks the control runtime.

config AINEKIO_BATTERY_DIVIDER_FACTOR
    string "Battery divider ratio"
    default "3.12766"
    help
        Planned ratio for the Parts Overview's 100k upper and 47k lower divider.
        H9 still measures the installed divider and stores ADC calibration.

endmenu
```
